/* source keypos definitions */
/* define linux host */
#define HOST_OS 1
#include "zmk-helpers/key-labels/42.h"
//#include <dt-bindings/zmk/backlight.h>
#include <dt-bindings/zmk/bt.h>
#include <dt-bindings/zmk/keys.h>
#include <dt-bindings/zmk/outputs.h>
#include <dt-bindings/zmk/rgb.h>
 
/* map Zen's extra keys */
#define X_LT  &kp GRAVE      // left row, up
#define X_LM  &kp LCTRL      // left row, middle
#define X_LB  &kp LSHFT     // left row, bottom
#define X_LH  SMART_NUM // thumb row, left

#define X_RT  &copy_cut // right row, up
#define X_RM  &kp SQT      // thumb row, middl
#define X_RB  &leader_sft           // thumb row, bottom
#define X_RH  &smart_shft // thumb row, right

/* activate bluetooth */
#define CONFIG_WIRELESS 1

/* source the main keymap */
#include "base.keymap"
